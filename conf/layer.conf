## conf/layer.conf
```bitbake
# We have a conf and classes directory, add to BBPATH
BBPATH =. "${LAYERDIR}:"

# We have a packages directory, add to BBFILES
BBFILES += "${LAYERDIR}/recipes-*/*/*.bb \
            ${LAYERDIR}/recipes-*/*/*.bbappend"

BBFILE_COLLECTIONS += "wr-llm"
BBFILE_PATTERN_wr-llm = "^${LAYERDIR}/"
BBFILE_PRIORITY_wr-llm = "5"

LAYERVERSION_wr-llm = "1"

LAYERSERIES_COMPAT_wr-llm = "wrynose"

LAYERDEPENDS_wr-llm = " \
    core \
"

LAYER_PATH_wr-llm = "${LAYERDIR}"

NON_MULTILIB_RECIPES:append = " llm llama-cpp"

PREFERRED_RPROVIDER_deepseek-r1-common ?= "ol-deepseek-r1-1dot5b"
PREFERRED_RPROVIDER_llama3.2-common ?= "ol-llama3.2-1b"
PREFERRED_RPROVIDER_qwen3-common ?= "ol-qwen3-1dot7b"
PREFERRED_RPROVIDER_gemma2-common ?= "ol-gemma2-2b"

BBFILES_DYNAMIC += " \
    tegra:${LAYERDIR}/dynamic-layers/meta-tegra/recipes*/*/*.bb \
    tegra:${LAYERDIR}/dynamic-layers/meta-tegra/recipes*/*/*.bbappend \
"
```
